## Kconfig
```kconfig
menu "ush"
	choice
		prompt "linebreak"
		default USH_LINEBREAK_LF

	config USH_LINEBREAK_LF
		bool "LF"

	config USH_LINEBREAK_CRLF
		bool "CRLF"
	endchoice
	
	config USH_TERM_READER_RINGMASK_BITS
		int "terminal reader circular buffer mask bits(aka size!)"
		default 8 

	config USH_TERM_HISTORY_RINGMASK_BITS
		int "terminal history circular buffer mask bits(aka size!)"
		default 4 

	config USH_TERM_LINESIZE
		int "terminal command line size."
		default 256

	config USH_PROMPT
		string "shell prompt"
		default "esp32"

endmenu


# 	config USH_TERM_READER_TIMEOUT_US
# 		int "terminal reader timeout in microseconds."
# 		default 1000
```
